## boards/nxp/frdm_kw38z/Kconfig.frdm_kw38z
```kconfig
# Copyright 2024 NXP
# SPDX-License-Identifier: Apache-2.0

config BOARD_FRDM_KW38Z
	select SOC_MKW38Z4
	select SOC_PART_NUMBER_MKW38Z512VHT4
```

## boards/nxp/frdm_kw38z/board.yml
```yaml
# Copyright (c) 2017, NXP
# SPDX-License-Identifier: Apache-2.0

board:
  name: frdm_kw38z
  vendor: nxp
  socs:
    - name: mkw38z4
```
